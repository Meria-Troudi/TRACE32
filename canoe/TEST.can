/*@!Encoding:1252*/

variables
  {
    msTimer   timeoutTimer;
    char  testPath[1024];
    char  testResult[2048];
    int testCount;         
    int  testOutcome;       
    int  timedOut;     
    const long WAIT_MS = 30000;    
    int len, token, joinRes, cnt, ok;
       int countPass = 0;
    int countFail = 0;
    long successMarker ;
    long  pos;
      long failMarker  ;
 
  }

 int validatePath(char p[])
  {
    len = strlen(p);
    if (p[0]=='\0' || len < 5
        || p[len-4] != '.'
        || toLower(p[len-3]) != 'c'
        || toLower(p[len-2]) != 'm'
        || toLower(p[len-1]) != 'm')
    {
      TestStepFail("Validation", "The specified path '%s' is invalid. Please check the file extension and try again.", p);
      return 0;
    }
    TestStepPass("Validation", "File path '%s' validated successfully.", p);
    return 1;
  }

 int validateCount(int c)
  {
    if (c < 1){
      TestStepFail("Validation", "Invalid count value: %d. Count must be at least 1.", c);
      return 0;
    }else{
    TestStepPass("Validation", "Test execution count set to %d.", c);
    return 1;
    }
  }
 
on timer timeoutTimer
  {
    timedOut = 1;
    TestStepFail("Timeout", "No <<<EOT>>> within %d?ms", WAIT_MS);
  }

int runCmm(char path[], int count)
  {
    sysSetVariableString(sysvar::cmm::path, path);
    sysSetVariableInt   (sysvar::cmm::count, count);
    sysSetVariableInt(sysvar::cmm::run, 1);
 
    TestStepPass("Trigger", "Run pressed for '%s' (count=%d)", path, count);
   
    token = TestJoinSysvarEvent(sysvar::cmm::result);
    joinRes = TestWaitForAnyJoinedEvent(WAIT_MS);
    sysSetVariableInt(sysvar::cmm::run, 0);
    
    if (joinRes == token){
      sysGetVariableString(sysvar::cmm::result,testResult,
        getValueSize(testResult)
      );
      TestStepPass("Receive", "Result received: %s", testResult);
      write("%s",testResult);

      countPass = 0;
      countFail = 0;
      // Count "SUCCESS"
      pos = 0;
      while ((pos = strstr_off(testResult, pos, "SUCCESS")) != -1)
      { countPass++;
        pos += 7;
      }
      // Count "FAIL"
      pos = 0;
      while ((pos = strstr_off(testResult, pos, "FAIL")) != -1)
      {
        countFail++;
        pos += 4;
      }      

       successMarker = strstr(testResult, "SUCCESS");
       failMarker = strstr(testResult, "FAIL");
       if (failMarker != -1){
        TestStepFail("Outcome", "FAIL detected. Total: PASS=%d, FAIL=%d", countPass, countFail);
        return 0;
      } else if (successMarker != -1){
        TestStepPass("Outcome", "SUCCESS detected. Total: PASS=%d, FAIL=%d", countPass, countFail);
        return 1;
      } else {
        TestStepFail("Outcome", "No definitive result marker. PASS=%d, FAIL=%d", countPass, countFail);
        return 0;
      }
    }else{
      TestStepFail("Timeout", "No result within %d?ms", WAIT_MS);
      return 0;
    }
  }

 testcase MainTest()
  {
    char pathBuf[512];
  
    TestModuleTitle("cmmTest");
    
    sysGetVariableString(sysvar::cmm::path, pathBuf, getValueSize(pathBuf));
    cnt = sysGetVariableInt(sysvar::cmm::count);

     if (!validatePath(pathBuf)) {
    TestStepFail("Validation", "Aborting test due to invalid path.");
    return; // Abort early
  }

  if (!validateCount(cnt)) {
    TestStepFail("Validation", "Aborting test due to invalid count.");
    return; // Abort early
  }
  
    
    ok = runCmm(pathBuf, cnt);
    if (ok)
      TestStepPass("","Test finished successfully.");
    else
      testStepFail("Test execution failed.");
  }